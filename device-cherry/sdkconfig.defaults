## device-cherry/sdkconfig.defaults
```kconfig
#TODO: Remove this after testing that it can be removed

# Rust often needs a bit of an extra main task stack size compared to C (the default is 3K)
CONFIG_ESP_SYSTEM_EVENT_TASK_STACK_SIZE=2304
CONFIG_ESP_MAIN_TASK_STACK_SIZE=16000

# Use this to set FreeRTOS kernel tick frequency to 1000 Hz (100 Hz by default).
# This allows to use 1 ms granularity for thread sleeps (10 ms by default).
#CONFIG_FREERTOS_HZ=1000

# Workaround for https://github.com/espressif/esp-idf/issues/7631
#CONFIG_MBEDTLS_CERTIFICATE_BUNDLE=n
#CONFIG_MBEDTLS_CERTIFICATE_BUNDLE_DEFAULT_FULL=n

#
# PThreads
#
CONFIG_PTHREAD_TASK_PRIO_DEFAULT=5
CONFIG_PTHREAD_TASK_STACK_SIZE_DEFAULT=12288
CONFIG_PTHREAD_STACK_MIN=3072
CONFIG_PTHREAD_DEFAULT_CORE_NO_AFFINITY=y
# CONFIG_PTHREAD_DEFAULT_CORE_0 is not set
# CONFIG_PTHREAD_DEFAULT_CORE_1 is not set
CONFIG_PTHREAD_TASK_CORE_DEFAULT=-1
CONFIG_PTHREAD_TASK_NAME_DEFAULT="pthread"
# end of PThreads

CONFIG_CHERRYUSB=y
CONFIG_CHERRYUSB_DEVICE=y
CONFIG_CHERRYUSB_DEVICE_SPEED_FS=y
# CONFIG_CHERRYUSB_HOST is not set
# CONFIG_CHERRYUSB_HOST_CUSTOM=y
CONFIG_USBDEV_ADVANCE_DESC=y
CONFIG_CHERRY_USB_DEVICE_CDC=y
CONFIG_CHERRY_USB_PORT_PUSB2=y
# CONFIG_CHERRYUSB_HOST_EHCI_BL is not set
# CONFIG_CHERRYUSB_HOST_EHCI_HPM is not set
# CONFIG_CHERRYUSB_HOST_EHCI_AIC is not set
# CONFIG_CHERRYUSB_HOST_EHCI_MCX is not set
# CONFIG_CHERRYUSB_HOST_EHCI_NUC980 is not set
# CONFIG_CHERRYUSB_HOST_EHCI_MA35D0 is not set
# CONFIG_CHERRYUSB_HOST_EHCI_CUSTOM is not set
# CONFIG_CHERRYUSB_HOST_DWC2_ST is not set
# CONFIG_CHERRYUSB_HOST_DWC2_ESP is not set
# CONFIG_CHERRYUSB_HOST_DWC2_HC is not set
# CONFIG_CHERRYUSB_HOST_DWC2_KENDRYTE is not set
# CONFIG_CHERRYUSB_HOST_DWC2_CUSTOM is not set
# CONFIG_CHERRYUSB_HOST_MUSB_ES is not set
# CONFIG_CHERRYUSB_HOST_MUSB_SUNXI is not set
# CONFIG_CHERRYUSB_HOST_MUSB_BK is not set
# CONFIG_CHERRYUSB_HOST_MUSB_CUSTOM is not set
# CONFIG_CHERRYUSB_HOST_PUSB2 is not set
# CONFIG_CHERRYUSB_HOST_XHCI_PHYTIUM is not set
# CONFIG_CHERRYUSB_HOST_XHCI_CUSTOM is not set
# CONFIG_CHERRYUSB_HOST_KINETIS_MCX is not set
# CONFIG_CHERRYUSB_HOST_KINETIS_MM32 is not set
# CONFIG_CHERRYUSB_HOST_KINETIS_CUSTOM is not set
# CONFIG_CHERRYUSB_HOST_CDC_ACM is not set
CONFIG_CHERRYUSB_DEVICE_CDC_ACM=y
CONFIG_CHERRYUSB_DEVICE_CDC=y
# CONFIG_CHERRYUSB_HOST_HID is not set
# CONFIG_CHERRYUSB_HOST_MSC is not set
# CONFIG_CHERRYUSB_HOST_CDC_ECM is not set
# CONFIG_CHERRYUSB_HOST_CDC_RNDIS is not set
# CONFIG_CHERRYUSB_HOST_CDC_NCM is not set
# CONFIG_CHERRYUSB_HOST_VIDEO is not set
# CONFIG_CHERRYUSB_HOST_AUDIO is not set
# CONFIG_CHERRYUSB_HOST_BLUETOOTH is not set
# CONFIG_CHERRYUSB_HOST_ASIX is not set
# CONFIG_CHERRYUSB_HOST_RTL8152 is not set
# CONFIG_CHERRYUSB_HOST_FTDI is not set
# CONFIG_CHERRYUSB_HOST_CH34X is not set
# CONFIG_CHERRYUSB_HOST_CP210X is not set
# CONFIG_CHERRYUSB_HOST_PL2303 is not set
# CONFIG_CHERRYUSB_HOST_AOA is not set
# CONFIG_CHERRYUSB_HOST_TEMPLATE is not set
CONFIG_CHERRYUSB_DEVICE_TEMPLATE_NONE=y
CONFIG_ESP_SYSTEM_PANIC_PRINT_REBOOT=y
# end of Component config


CONFIG_USBHOST_MAX_EXTHUBS=1
CONFIG_USBHOST_MAX_EHPORTS=4
CONFIG_USBHOST_MAX_INTERFACES=8
CONFIG_USBHOST_MAX_INTF_ALTSETTINGS=8
CONFIG_USBHOST_MAX_ENDPOINTS=4
CONFIG_USBHOST_MAX_CDC_ACM_CLASS=4
CONFIG_USBHOST_MAX_HID_CLASS=4
CONFIG_USBHOST_MAX_MSC_CLASS=2
CONFIG_USBHOST_MAX_AUDIO_CLASS=1
CONFIG_USBHOST_MAX_VIDEO_CLASS=1
```

## plugin-std/sdkconfig.defaults
```kconfig
# Rust often needs a bit of an extra main task stack size compared to C (the default is 3K)
CONFIG_ESP_MAIN_TASK_STACK_SIZE=16000

# Nimble configurations
CONFIG_BT_ENABLED=y
CONFIG_BT_BLE_ENABLED=y
CONFIG_BT_BLUEDROID_ENABLED=n
CONFIG_BT_NIMBLE_ENABLED=y
# Persist iOS bonding
CONFIG_BT_NIMBLE_NVS_PERSIST=y


#
# PThreads
#
CONFIG_PTHREAD_TASK_PRIO_DEFAULT=5
CONFIG_PTHREAD_TASK_STACK_SIZE_DEFAULT=52288
CONFIG_PTHREAD_STACK_MIN=9072
CONFIG_PTHREAD_DEFAULT_CORE_NO_AFFINITY=y
# CONFIG_PTHREAD_DEFAULT_CORE_0 is not set
# CONFIG_PTHREAD_DEFAULT_CORE_1 is not set
CONFIG_PTHREAD_TASK_CORE_DEFAULT=-1
CONFIG_PTHREAD_TASK_NAME_DEFAULT="pthread"
# end of PThreads



CONFIG_CHERRYUSB=y
CONFIG_CHERRYUSB_DEVICE=y
CONFIG_CHERRYUSB_DEVICE_SPEED_FS=y
# CONFIG_CHERRYUSB_HOST is not set
CONFIG_CHERRYUSB_HOST_CUSTOM=y
# CONFIG_CHERRYUSB_HOST_EHCI_BL is not set
# CONFIG_CHERRYUSB_HOST_EHCI_HPM is not set
# CONFIG_CHERRYUSB_HOST_EHCI_AIC is not set
# CONFIG_CHERRYUSB_HOST_EHCI_MCX is not set
# CONFIG_CHERRYUSB_HOST_EHCI_NUC980 is not set
# CONFIG_CHERRYUSB_HOST_EHCI_MA35D0 is not set
# CONFIG_CHERRYUSB_HOST_EHCI_CUSTOM is not set
# CONFIG_CHERRYUSB_HOST_DWC2_ST is not set
# CONFIG_CHERRYUSB_HOST_DWC2_ESP is not set
# CONFIG_CHERRYUSB_HOST_DWC2_HC is not set
# CONFIG_CHERRYUSB_HOST_DWC2_KENDRYTE is not set
# CONFIG_CHERRYUSB_HOST_DWC2_CUSTOM is not set
# CONFIG_CHERRYUSB_HOST_MUSB_ES is not set
# CONFIG_CHERRYUSB_HOST_MUSB_SUNXI is not set
# CONFIG_CHERRYUSB_HOST_MUSB_BK is not set
# CONFIG_CHERRYUSB_HOST_MUSB_CUSTOM is not set
# CONFIG_CHERRYUSB_HOST_PUSB2 is not set
# CONFIG_CHERRYUSB_HOST_XHCI_PHYTIUM is not set
# CONFIG_CHERRYUSB_HOST_XHCI_CUSTOM is not set
# CONFIG_CHERRYUSB_HOST_KINETIS_MCX is not set
# CONFIG_CHERRYUSB_HOST_KINETIS_MM32 is not set
# CONFIG_CHERRYUSB_HOST_KINETIS_CUSTOM is not set
# CONFIG_CHERRYUSB_HOST_CDC_ACM is not set
CONFIG_CHERRYUSB_DEVICE_CDC_ACM=y
# CONFIG_CHERRYUSB_HOST_HID is not set
# CONFIG_CHERRYUSB_HOST_MSC is not set
# CONFIG_CHERRYUSB_HOST_CDC_ECM is not set
# CONFIG_CHERRYUSB_HOST_CDC_RNDIS is not set
# CONFIG_CHERRYUSB_HOST_CDC_NCM is not set
# CONFIG_CHERRYUSB_HOST_VIDEO is not set
# CONFIG_CHERRYUSB_HOST_AUDIO is not set
# CONFIG_CHERRYUSB_HOST_BLUETOOTH is not set
# CONFIG_CHERRYUSB_HOST_ASIX is not set
# CONFIG_CHERRYUSB_HOST_RTL8152 is not set
# CONFIG_CHERRYUSB_HOST_FTDI is not set
# CONFIG_CHERRYUSB_HOST_CH34X is not set
# CONFIG_CHERRYUSB_HOST_CP210X is not set
# CONFIG_CHERRYUSB_HOST_PL2303 is not set
# CONFIG_CHERRYUSB_HOST_AOA is not set
# CONFIG_CHERRYUSB_HOST_TEMPLATE is not set
CONFIG_CHERRYUSB_DEVICE_TEMPLATE_NONE=y
CONFIG_ESP_SYSTEM_PANIC_PRINT_REBOOT=y
# end of Component config


CONFIG_USBHOST_MAX_EXTHUBS=1
CONFIG_USBHOST_MAX_EHPORTS=4
CONFIG_USBHOST_MAX_INTERFACES=8
CONFIG_USBHOST_MAX_INTF_ALTSETTINGS=8
CONFIG_USBHOST_MAX_ENDPOINTS=4
CONFIG_USBHOST_MAX_CDC_ACM_CLASS 4
CONFIG_USBHOST_MAX_HID_CLASS=4
CONFIG_USBHOST_MAX_MSC_CLASS=2
CONFIG_USBHOST_MAX_AUDIO_CLASS=1
CONFIG_USBHOST_MAX_VIDEO_CLASS=1
```
